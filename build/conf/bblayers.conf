## build/conf/bblayers.conf
```bitbake
# POKY_BBLAYERS_CONF_VERSION is increased each time build/conf/bblayers.conf
# changes incompatibly
POKY_BBLAYERS_CONF_VERSION = "2"

BBPATH = "${TOPDIR}"
BBFILES ?= ""

BBLAYERS ?= " \
    /var/lib/jenkins/workspace/fetch-rpi-yocto/poky/meta \
    /var/lib/jenkins/workspace/fetch-rpi-yocto/poky/meta-poky \
    /var/lib/jenkins/workspace/fetch-rpi-yocto/poky/meta-openembedded/meta-oe \
    /var/lib/jenkins/workspace/fetch-rpi-yocto/poky/meta-openembedded/meta-multimedia \
    /var/lib/jenkins/workspace/fetch-rpi-yocto/poky/meta-openembedded/meta-networking \
    /var/lib/jenkins/workspace/fetch-rpi-yocto/poky/meta-openembedded/meta-perl \
    /var/lib/jenkins/workspace/fetch-rpi-yocto/poky/meta-openembedded/meta-python \
    /var/lib/jenkins/workspace/fetch-rpi-yocto/poky/meta-qt5 \
    /var/lib/jenkins/workspace/fetch-rpi-yocto/poky/meta-raspberrypi \
    /var/lib/jenkins/workspace/image-rpi3bplus/ \
"
```

## build/conf/local.conf
```bitbake
# Local configuration for meta-rpi images
# Yocto Project 2.7 Poky distribution [warrior] branch
# This is a sysvinit system


DISTRO_FEATURES = "ext2 usbhost ${DISTRO_FEATURES_LIBC} bluez5 bluetooth wifi systemd"
DISTRO_FEATURES_BACKFILL_CONSIDERED += "pulseaudio"
DISTRO_FEATURES_remove = "x11"

KERNEL_MODULE_AUTOLOAD += "hci_uart"

PREFERRED_PROVIDER_udev = "eudev"
VIRTUAL-RUNTIME_init_manager = "systemd"

MACHINE_FEATURES_remove = "apm"

MACHINE = "raspberrypi3-64"

DISABLE_OVERSCAN = "1"
ENABLE_UART = "0"

PREFERRED_VERSION_linux-raspberrypi = "4.19.%"

DISTRO = "poky"
PACKAGE_CLASSES = "package_ipk"

SDKMACHINE = "x86_64"

EXTRA_IMAGE_FEATURES = "debug-tweaks"

USER_CLASSES = "image-mklibs image-prelink"
PATCHRESOLVE = "noop"
RM_OLD_IMAGE = "1"
INHERIT += "rm_work"
CONF_VERSION = "1"
IMAGE_FSTYPES = "tar.bz2 ext3 rpi-sdimg"
```
